## CMakeLists.txt
```
cmake_minimum_required(VERSION 3.20.0)
find_package(Zephyr REQUIRED HINTS $ENV{ZEPHYR_BASE})

project(zephyr_amp_heartbeat)

target_sources(app PRIVATE src/main.c)
```

## prj.conf
```kconfig
# First AMP bring-up image: do not claim the shared Debug UART.
CONFIG_CONSOLE=n
CONFIG_SERIAL=n
CONFIG_UART_INTERRUPT_DRIVEN=n

# RK3588S Zephyr support requires the architected timer and GIC.  Do not
# reconfigure the shared distributor when another OS has already enabled it.
CONFIG_GIC_SAFE_CONFIG=y
# Zephyr ARM64 IRQ entry requires the scheduler switch symbols even though
# this smoke-test application creates no additional threads.
CONFIG_MULTITHREADING=y
```

## boards/roc_rk3588_pc.overlay
```dts
/*
 * This is deliberately a CPU-start smoke test, not an IPC or peripheral test.
 * Linux continues to own the GIC distributor and Debug UART.  GIC remains
 * enabled so the SoC timer dependency is met; CONFIG_GIC_SAFE_CONFIG avoids
 * distributor reconfiguration when it has already been enabled by Linux.
 */
&uart2 {
	status = "disabled";
};
```

## src/main.c
```c
/*
 * First secondary-CPU smoke-test payload.
 *
 * The status page is inside the 1 MiB Zephyr carveout, away from the current
 * small image.  Before any board run, the ELF layout must prove that it does
 * not overlap this address.
 */
#include <stdint.h>

#define AMP_STATUS_ADDR 0x500ff000UL
#define AMP_MAGIC       0x414d5031ULL /* "AMP1" */

static inline uint64_t current_el(void)
{
	uint64_t value;

	__asm__ volatile ("mrs %0, CurrentEL" : "=r" (value));
	return value >> 2;
}

static inline void publish(const volatile uint64_t *address)
{
	__asm__ volatile ("dc cvac, %0" : : "r" (address) : "memory");
	__asm__ volatile ("dsb sy" : : : "memory");
}

void main(void)
{
	volatile uint64_t *const status = (volatile uint64_t *)AMP_STATUS_ADDR;

	status[0] = AMP_MAGIC;
	status[1] = current_el();
	publish(status);

	for (;;) {
		__asm__ volatile ("wfe");
	}
}
```
